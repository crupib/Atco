GLOBAL Pi AS DOUBLE
GLOBAL TXT AS STRING
GLOBAL a,b, DelH, DelV, s, s1 AS DOUBLE
GLOBAL i, j, n1, n2, n3,  kmax,sel AS LONG
GLOBAL x,x1,y,y1 AS DOUBLE
GLOBAL demo AS LONG
GLOBAL usecolor AS LONG
GLOBAL kbd AS STRING
GLOBAL AE, AO, ED, OE, AB, area, AOE,ce,eb AS DOUBLE
GLOBAL centerx, centery AS LONG
GLOBAL radius AS LONG
GLOBAL central_angle, arc_ABD, arc_ABR, arclen_AB AS DOUBLE
GLOBAL circumference,chord_AB, circle_area AS DOUBLE
GLOBAL Sector_area AS DOUBLE
GLOBAL Arc_AB AS DOUBLE
GLOBAL Triangle_Area, Segment_area AS DOUBLE
%IDC_GRAPHIC1 = 110
%IDC_EDITBOX1 = 111
%IDC_LABEL1 = 1112
%IDC_LABEL2 = 1113
%IDC_LABEL3 = 1114
%IDC_LABEL4 = 1115
%IDC_LABEL5 = 1116
%IDC_LABEL6 = 1117
%IDC_LABEL7 = 1118
%IDC_LABEL8 = 1119
%IDC_LABEL9 = 1110
%IDC_LABEL10 = 1101
%IDC_LABEL11 = 1102

%IDC_EDITBOX2 = 113
%IDC_EDITBOX3 = 114
%IDC_EDITBOX4 = 115
%IDC_EDITBOX5 = 116
%IDC_EDITBOX6 = 117
%IDC_EDITBOX7 = 118
%IDC_EDITBOX8 = 119
%IDC_EDITBOX9 = 120
%IDC_EDITBOX10 = 121
%IDC_EDITBOX11 = 122
%OPT1 = 1001
%OPT2 = 1002
%OPT3 = 1003
%OPT4 = 1004
%OPT5 = 1005
%OPT6 = 1006
%OPT7 = 1007
%OPT8 = 1008
%OPT9 = 1009
