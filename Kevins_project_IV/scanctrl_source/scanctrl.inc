' include shared values
' bc
'
%MAIN_TEXTXPOS           = 100
%MAIN_BUTTONXPOS         = 105
%MAIN_BUTTONXONOFF       = 110
%MAIN_TEXTYPOS           = 115
%MAIN_BUTTONYPOS         = 120
%MAIN_BUTTONYONOFF       = 125
%MAIN_TEXTRPOS           = 130
%MAIN_BUTTONRPOS         = 135
%MAIN_BUTTONRONOFF       = 140
%MAIN_BUTTONPOLAR        = 145
%MAIN_BUTTONCARTESIAN    = 150
%MAIN_BUTTONALLPOS       = 155
%MAIN_BUTTONALLOFF       = 160
%MAIN_BUTTONALLON        = 165
%MAIN_BUTTONGOSCAN       = 170
%MAIN_BUTTONEXTRASCAN    = 175
%MAIN_BUTTONSTOPSCAN     = 180
%MAIN_BUTTONJOGYPLUS     = 185
%MAIN_BUTTONJOGXMINUS    = 190
%MAIN_BUTTONJOGXPLUS     = 195
%MAIN_BUTTONJOGYMINUS    = 200
%MAIN_BUTTONJOGRPLUS     = 205
%MAIN_BUTTONJOGRMINUS    = 210
%MAIN_CANVASJOGCONTROL   = 215
%MAIN_TRACKBARJOGRATE    = 220
%MAIN_TEXTJOGRATE        = 225
%MAIN_BUTTONJOGCONT      = 230
%MAIN_BUTTONJOGSTEP      = 235
%MAIN_BUTTONEXTRA        = 240     ' first extra button ID (18 buttons total)
%MAIN_BUTTONEXTRA0       = 0
%MAIN_BUTTONEXTRA1       = 1
%MAIN_BUTTONEXTRA2       = 2
%MAIN_BUTTONEXTRA3       = 3
%MAIN_BUTTONEXTRA4       = 4
%MAIN_BUTTONEXTRA5       = 5
%MAIN_BUTTONEXTRA6       = 6
%MAIN_BUTTONEXTRA7       = 7
%MAIN_BUTTONEXTRA8       = 8
%MAIN_BUTTONEXTRA9       = 9
%MAIN_BUTTONEXTRA10       = 10
%MAIN_BUTTONEXTRA11       = 11
%MAIN_BUTTONEXTRA12       = 12
%MAIN_BUTTONEXTRA13       = 13
%MAIN_BUTTONEXTRA14       = 14
%MAIN_BUTTONEXTRA15       = 15
%MAIN_BUTTONEXTRA16       = 16
%MAIN_BUTTONEXTRA17       = 17
%MAIN_BUTTONEXTRA18       = 18
%MAIN_MAINCANVAS         = 330
MACRO CONST = MACRO
'misc const values
CONST ENABLE = -1
CONST DISABLE = 0
