%IDC_GRAPHIC1 = 110
%IDC_EDITBOX1 = 111
%IDC_LABEL1 = 1112
%IDC_LABEL2 = 1113
%IDC_LABEL3 = 1114
%IDC_LABEL4 = 1115
%IDC_LABEL5 = 1116
%IDC_LABEL6 = 1117
%IDC_LABEL7 = 1118
%IDC_LABEL8 = 1119
%IDC_LABEL9 = 1110
%IDC_LABEL10 = 1101
%IDC_LABEL11 = 1102
%IDC_LABEL12 = 1103
%IDC_LABEL13 = 1104
%IDC_LABEL14 = 1105
%IDC_LABEL15 = 1106
%IDC_LABEL20 = 4000
%IDC_LABEL21 = 4001
%IDC_LABEL22 = 4002
%IDC_LABEL23 = 4003
%IDC_LABEL24 = 4004
%IDC_LABEL25 = 4005
%IDC_LABEL26 = 4006
%IDC_LABEL27 = 4007
%IDC_EDITBOX2 = 113
%IDC_EDITBOX3 = 114
%IDC_EDITBOX4 = 115
%IDC_EDITBOX5 = 116
%IDC_EDITBOX6 = 117
%IDC_EDITBOX7 = 118
%IDC_EDITBOX8 = 119
%IDC_EDITBOX9 = 120
%IDC_EDITBOX10 = 121
%IDC_EDITBOX11 = 122
%IDC_EDITBOX12 = 123
%IDC_EDITBOX13 = 124
%IDC_EDITBOX14 = 125
%IDC_EDITBOX15 = 126
%IDC_EDITBOX20 = 3000
%IDC_EDITBOX21 = 3001
%IDC_EDITBOX22 = 3002
%IDC_EDITBOX23 = 3003
%IDC_EDITBOX24 = 3004
%IDC_EDITBOX25 = 3005
%IDC_EDITBOX26 = 3006
%IDC_EDITBOX27 = 3007
%IDC_TextBox   = 123
%IDC_UpDown = 124
%IDC_LABSPIN = 125
%OPT1 = 1001
%OPT2 = 1002
%OPT3 = 1003
%OPT4 = 1004
%OPT5 = 1005
%OPT6 = 1006
%OPT7 = 1007
%OPT8 = 1008
%OPT9 = 1009
%SETUP_BUTTON = 2000
%JOYSTICK_BUTTON = 2010
%AJOG = 2020
%SAVE = 2030
%AUTOSCAN = 2040
%XSPDCTRL = 2050
%MJOG = 2060
%LOAD = 2070
%CALIBRATEENC = 2080
